## conf/bblayers.conf
```bitbake
# POKY_BBLAYERS_CONF_VERSION is increased each time build/conf/bblayers.conf
# changes incompatibly
POKY_BBLAYERS_CONF_VERSION = "2"

BBPATH = "${TOPDIR}"
BBFILES ?= ""

BBLAYERS ?= " \
  <poky-dir>/meta \
  <poky-dir>/meta-poky \
  <poky-dir>/meta-yocto-bsp \
  <poky-dir>/meta-intel \
  <poky-dir>/meta-openembedded/meta-oe \
  <poky-dir>/meta-openembedded/meta-python \
  <poky-dir>/meta-python2 \
  <poky-dir>/meta-ros/meta-ros-common \
  <poky-dir>/meta-ros/meta-ros-python2 \
  <poky-dir>/meta-ros/meta-ros1 \
  <poky-dir>/meta-ros/meta-ros1-melodic \
  "
```
